## drivers/net/wireless/Kconfig.rej
```kconfig
--- drivers/net/wireless/Kconfig
+++ drivers/net/wireless/Kconfig
@@ -287,6 +287,7 @@
 source "drivers/net/wireless/zd1211rw/Kconfig"
 source "drivers/net/wireless/bcm4329/Kconfig"
 source "drivers/net/wireless/bcm4329_204/Kconfig"
+source "drivers/net/wireless/bcmdhd/Kconfig"
 source "drivers/net/wireless/tiwlan1251/Kconfig"
 
 endif # WLAN
```
